## lib/ecc/Kconfig
```kconfig
config ECC
	bool "Use ECC Library"
	help
	  ECC support. This enables the ECC algorithm used for FIT image
	  verification in U-Boot.
	  The signing part is build into mkimage regardless of this
	  option. The software based modular exponentiation is built into
	  mkimage irrespective of this option.
```
